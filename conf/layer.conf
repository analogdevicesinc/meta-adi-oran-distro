## conf/layer.conf
```bitbake
# We have a conf and classes directory, append to BBPATH
BBPATH:append = ":${LAYERDIR}"

# We have a recipes directory, add to BBFILES
BBFILES:append = " ${LAYERDIR}/recipes*/*/*.bb \
                   ${LAYERDIR}/recipes*/*/*.bbappend \
                   ${LAYERDIR}/recipes*/*/*/*.bb \
                   ${LAYERDIR}/recipes*/*/*/*.bbappend "

BBFILE_COLLECTIONS:append = " meta-adi-oran-distro"
BBFILE_PATTERN_meta-adi-oran-distro := "^${LAYERDIR}/"

# Set the layer priority
BBFILE_PRIORITY:meta-adi-oran-distro = "6"
# Layer dependencies
LAYERDEPENDS:meta-adi-oran-distro:append =  " core"

# Version decsription:              stable
LAYERSERIES_COMPAT_meta-adi-oran-distro = "kirkstone"

# Additional license directories
#LICENSE_PATH:append = " ${LAYERDIR}/files/custom-licenses"

BBDEBUG = "yes"
```
